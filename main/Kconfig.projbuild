## main/Kconfig.projbuild
```kconfig
menu "Argus V2 Pump Controller Configuration"

    config ARGUS_DIAGNOSTIC_MODE
        bool "Enable Diagnostic Pulse-Test Mode"
        default n
        help
            Enables automated unit testing and the interactive serial command menu on startup.
            WARNING: Diagnostic mode is for testing only. Keep disabled in production.

    config ARGUS_RUN_TESTS_AT_BOOT
        bool "Run the pure unit suite once at boot"
        depends on ARGUS_DIAGNOSTIC_MODE
        default n
        help
            Runs the same suite as the interactive menu's [t] command once,
            automatically, shortly after startup, then continues into normal
            operation.

            Exists because the diagnostic console cannot be driven by a script
            over this board's USB-Serial-JTAG interface: asserting DTR holds
            the chip in reset and asserting RTS resets it, so there is no way
            to send a keypress without rebooting the device. That makes the
            suite unrunnable in any automated or unattended flow, and forces a
            human to sit at a terminal to verify a build.

            The suite is read-only with respect to production state - it
            carries its own isolation proof over authority, machine state,
            network mode, NVS and broker lifecycle - so running it at boot
            does not disturb the controller. It does delay reaching steady
            state by the duration of the run.

            Keep disabled by default. Enable it for a verification build, read
            the result over the serial log, and disable it again. Never ship
            it enabled: a production controller should not spend its startup
            running tests.

    config ARGUS_SERVICE_AP_PASS
        string "Shared Service AP WPA2 Password"
        default ""
        help
            Shared internal Argus service AP password. Privately provisioned at build time.
            Default is empty string; must be configured in untracked local sdkconfig (8..63 chars).

    config ARGUS_WIFI_SSID
        string "Wi-Fi SSID"
        default ""
        help
            SSID of the target Wi-Fi network. Credentials must be provisioned or configured.

    config ARGUS_WIFI_PASSWORD
        string "Wi-Fi Password"
        default ""
        help
            WPA2 Password of the target Wi-Fi network. Keep blank to configure via provisioning.

    config ARGUS_CLIENT_NAME
        string "Commissioned Client Name"
        default "dev_client"
        help
            Client name prefix used in dynamic MQTT topic configurations.

    config ARGUS_UNIT_ID
        string "Commissioned Unit ID"
        default "pump_v2_001"
        help
            Peristaltic pump unit identifier.

    config ARGUS_DISPLACEMENT_GAL_PER_REV
        string "Provisional Displacement (Gal/Rev)"
        default "0.04"
        help
            Provisional displacement factor (unconfirmed commissioning configuration).

endmenu
```
