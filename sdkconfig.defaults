## sdkconfig.defaults
```kconfig
CONFIG_IDF_TARGET="esp32s3"
CONFIG_PARTITION_TABLE_CUSTOM=y
CONFIG_PARTITION_TABLE_CUSTOM_FILENAME="partitions.csv"
CONFIG_ESPTOOLPY_FLASHMODE_QIO=y
CONFIG_ESPTOOLPY_FLASHSIZE_16MB=y
CONFIG_FREERTOS_HZ=1000

# Diagnostic Pulse-Test Mode enabled by default for this testing cycle
CONFIG_ARGUS_DIAGNOSTIC_MODE=y

# Use USB Serial/JTAG Controller for console input/output (COM port)
CONFIG_ESP_CONSOLE_USB_SERIAL_JTAG=y

# IRAM Safety configurations for V2 Stepper ISR
CONFIG_GPIO_CTRL_FUNC_IN_IRAM=y
CONFIG_GPTIMER_CTRL_FUNC_IN_IRAM=y
CONFIG_GPTIMER_ISR_HANDLER_IN_IRAM=y
CONFIG_GPTIMER_ISR_CACHE_SAFE=y
```
